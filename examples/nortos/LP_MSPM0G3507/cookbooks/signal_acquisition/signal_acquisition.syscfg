// @cliArgs --device "MSPM0G350X" --package "LQFP-64(PM)" --part "Default"
// @cliArgs --board /ti/boards/LP_MSPM0G3507 --rtos nortos

/**
 * Import the modules used in this configuration.
 */
const ADC12  = scripting.addModule("/ti/driverlib/ADC12", {}, false);
const ADC121 = ADC12.addInstance();
const SYSCTL = scripting.addModule("/ti/driverlib/SYSCTL");

/**
 * Write custom configuration values to the imported modules.
 */
ADC121.$name              = "ADC12_0";
ADC121.sampClkSrc         = "DL_ADC12_CLOCK_ULPCLK";
ADC121.enableDMA          = false;
ADC121.adcMem5chansel     = "DL_ADC12_INPUT_CHAN_5";
ADC121.adcMem6chansel     = "DL_ADC12_INPUT_CHAN_6";
ADC121.adcMem7chansel     = "DL_ADC12_INPUT_CHAN_7";
ADC121.trigSrc            = "DL_ADC12_TRIG_SRC_EVENT";
ADC121.subChanID          = 1;
ADC121.adcMem3chansel     = "DL_ADC12_INPUT_CHAN_12";
ADC121.adcMem4chansel     = "DL_ADC12_INPUT_CHAN_13";
ADC121.sampClkDiv         = "DL_ADC12_CLOCK_DIVIDE_8";
ADC121.sampleTime0        = "125us";
ADC121.sampleTime1        = "12.5us";
ADC121.adcMem3_name       = "DAC12_OUT";
ADC121.adcMem4_name       = "OPT101_OUT";
ADC121.adcMem0avgen       = true;
ADC121.adcMem1avgen       = true;
ADC121.adcMem2avgen       = true;
ADC121.adcMem1chansel     = "DL_ADC12_INPUT_CHAN_13";
ADC121.adcMem2chansel     = "DL_ADC12_INPUT_CHAN_15";
ADC121.adcMem2_name       = "V_SUPPLY";
ADC121.adcMem1_name       = "OPA0_OUT";
ADC121.adcMem0chansel     = "DL_ADC12_INPUT_CHAN_13";
ADC121.enabledInterrupts  = ["DL_ADC12_INTERRUPT_MEM0_RESULT_LOADED"];
ADC121.peripheral.$assign = "ADC0";

const Board = scripting.addModule("/ti/driverlib/Board", {}, false);

SYSCTL.MFCLKEn           = true;
SYSCTL.validateClkStatus = true;
SYSCTL.forceDefaultClkConfig = true;
