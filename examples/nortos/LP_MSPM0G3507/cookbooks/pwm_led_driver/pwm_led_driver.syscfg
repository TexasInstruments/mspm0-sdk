// @cliArgs --device "MSPM0G350X" --package "LQFP-64(PM)" --part "Default"
// @cliArgs --board /ti/boards/LP_MSPM0G3507 --rtos nortos

/**
 * Import the modules used in this configuration.
 */
const PWM  = scripting.addModule("/ti/driverlib/PWM", {}, false);
const PWM1 = PWM.addInstance();

/**
 * Write custom configuration values to the imported modules.
 */
PWM1.$name                      = "PWM_1";
PWM1.ccIndex                    = [0];
PWM1.timerCount                 = 2000;
PWM1.timerStartTimer            = true;
PWM1.interrupts                 = ["LOAD_EVENT"];
PWM1.clockDivider               = 8;
PWM1.clockPrescale              = 20;
PWM1.peripheral.ccp0Pin.$assign = "ball.33";
PWM1.PWM_CHANNEL_0.$name        = "ti_driverlib_pwm_PWMTimerCC2";
PWM1.PWM_CHANNEL_0.dutyCycle    = 10;

const Board = scripting.addModule("/ti/driverlib/Board", {}, false);

const SYSCTL = scripting.addModule("/ti/driverlib/SYSCTL", {}, false);
SYSCTL.forceDefaultClkConfig = true;
