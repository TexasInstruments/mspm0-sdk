// @cliArgs --device "MSPM0G350X" --package "LQFP-64(PM)" --part "Default"
// @cliArgs --board /ti/boards/LP_MSPM0G3507 --rtos nortos

/**
 * Import the modules used in this configuration.
 */
const DAC12  = scripting.addModule("/ti/driverlib/DAC12");
const SYSCTL = scripting.addModule("/ti/driverlib/SYSCTL");

/**
 * Write custom configuration values to the imported modules.
 */
const gate8  = system.clockTree["MFPCLKGATE"];
gate8.enable = true;

DAC12.dacOutputPinEn       = true;
DAC12.dacAmplifier         = "ON";
DAC12.dacFIFOEn            = true;
DAC12.dacDMATrigger        = false;
DAC12.dacSampleTimerRate   = "16K";
DAC12.dacEnabledInterrupts = ["FIFO_TWO_QTRS_EMPTY"];
DAC12.dacOutput12          = 4095;

const Board = scripting.addModule("/ti/driverlib/Board", {}, false);

SYSCTL.MFPCLKEn          = true;
SYSCTL.enableSleepOnExit = true;
SYSCTL.forceDefaultClkConfig = true;
SYSCTL.clockTreeEn        = true;
