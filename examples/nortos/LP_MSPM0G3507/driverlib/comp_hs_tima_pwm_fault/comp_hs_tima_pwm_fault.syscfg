// @cliArgs --device "MSPM0G350X" --package "LQFP-64(PM)" --part "Default"
// @cliArgs --board /ti/boards/LP_MSPM0G3507 --rtos nortos

/**
 * Import the modules used in this configuration.
 */
const Board  = scripting.addModule("/ti/driverlib/Board");
const COMP   = scripting.addModule("/ti/driverlib/COMP", {}, false);
const COMP1  = COMP.addInstance();
const PWM    = scripting.addModule("/ti/driverlib/PWM", {}, false);
const PWM1   = PWM.addInstance();
const SYSCTL = scripting.addModule("/ti/driverlib/SYSCTL");
const VREF   = scripting.addModule("/ti/driverlib/VREF");

/**
 * Write custom configuration values to the imported modules.
 */
Board.InitPriority8 = "/ti/driverlib/VREF";

COMP1.selectOutputFilter             = "DL_COMP_FILTER_DELAY_1200";
COMP1.hysteresis                     = "DL_COMP_HYSTERESIS_30";
COMP1.vSource                        = "DL_COMP_REF_SOURCE_VDDA_DAC";
COMP1.controlSelect                  = "DL_COMP_DAC_CONTROL_SW";
COMP1.$name                          = "COMP";
COMP1.channelEnable                  = ["POS"];
COMP1.terminalSelect                 = "DL_COMP_REF_TERMINAL_SELECT_NEG";
COMP1.enableOutputFilter             = true;
COMP1.peripheral.$assign             = "COMP0";
COMP1.peripheral.compPinPos0.$assign = "PA26";

PWM1.$name                      = "PWM_0";
PWM1.faultHandlerEn             = true;
PWM1.faultInputEn               = "FIEN_ENABLED";
PWM1.faultInput                 = "FI_DEPENDENT";
PWM1.faultInputFilterEn         = true;
PWM1.faultTimerCountEntry       = "FAULT_ENTRY_CTR_SUSP_COUNT";
PWM1.faultTimerCountExit        = "FAULT_EXIT_CTR_CVAE_ACTION";
PWM1.faultInputDetect           = true;
PWM1.clockPrescale              = 256;
PWM1.timerCount                 = 2000;
PWM1.ccIndex                    = [0];
PWM1.faultSource                = ["3"];
PWM1.faultChannel0BehaviorEntry = "HIGHZ";
PWM1.COMP0Sense                 = "SENSE_HIGH";
PWM1.peripheral.$assign         = "TIMA0";
PWM1.peripheral.ccp0Pin.$assign = "PB8";
PWM1.PWM_CHANNEL_0.$name        = "ti_driverlib_pwm_PWMTimerCC0";
PWM1.PWM_CHANNEL_0.ccValue      = 500;

SYSCTL.forceDefaultClkConfig = true;
SYSCTL.clockTreeEn  = true;
