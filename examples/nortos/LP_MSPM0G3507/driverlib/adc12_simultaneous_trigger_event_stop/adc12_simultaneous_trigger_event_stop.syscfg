// @cliArgs --device "MSPM0G350X" --package "LQFP-64(PM)" --part "Default"
// @cliArgs --board /ti/boards/LP_MSPM0G3507 --rtos nortos

/**
 * Import the modules used in this configuration.
 */
const Board = scripting.addModule("/ti/driverlib/Board");
const SYSCTL = scripting.addModule("/ti/driverlib/SYSCTL");
const ADC12  = scripting.addModule("/ti/driverlib/ADC12", {}, false);
const ADC121 = ADC12.addInstance();
const ADC122 = ADC12.addInstance();
const GPIO   = scripting.addModule("/ti/driverlib/GPIO", {}, false);
const GPIO1  = GPIO.addInstance();
const TIMER  = scripting.addModule("/ti/driverlib/TIMER", {}, false);
const TIMER1 = TIMER.addInstance();

/**
 * Write custom configuration values to the imported modules.
 */
ADC121.$name              = "ADC12_0";
ADC121.enabledInterrupts  = ["DL_ADC12_INTERRUPT_MEM0_RESULT_LOADED"];
ADC121.sampClkDiv         = "DL_ADC12_CLOCK_DIVIDE_8";
ADC121.sampClkSrc         = "DL_ADC12_CLOCK_ULPCLK";
ADC121.trigSrc            = "DL_ADC12_TRIG_SRC_EVENT";
ADC121.adcMem0chansel     = "DL_ADC12_INPUT_CHAN_2";
ADC121.sampleTime0        = "25 us";
ADC121.adcMem0avgen       = true;
ADC121.hwNumerator        = "DL_ADC12_HW_AVG_NUM_ACC_128";
ADC121.hwDenominator      = "DL_ADC12_HW_AVG_DEN_DIV_BY_128";
ADC121.subChanID          = 12;
ADC121.peripheral.$assign = "ADC0";
ADC121.peripheral.adcPin2.$assign   = "PA25";

ADC122.$name             = "ADC12_1";
ADC122.sampClkSrc        = "DL_ADC12_CLOCK_ULPCLK";
ADC122.sampClkDiv        = "DL_ADC12_CLOCK_DIVIDE_8";
ADC122.trigSrc           = "DL_ADC12_TRIG_SRC_EVENT";
ADC122.adcMem0chansel    = "DL_ADC12_INPUT_CHAN_2";
ADC122.adcMem0avgen      = true;
ADC122.hwNumerator       = "DL_ADC12_HW_AVG_NUM_ACC_32";
ADC122.hwDenominator     = "DL_ADC12_HW_AVG_DEN_DIV_BY_32";
ADC122.sampleTime0       = "25 us";
ADC122.enabledInterrupts = ["DL_ADC12_INTERRUPT_MEM0_RESULT_LOADED"];
ADC122.subChanID         = 12;
ADC122.peripheral.$assign           = "ADC1";
ADC122.peripheral.adcPin2.$assign   = "PA17";

Board.configureUnused = true;

GPIO1.$name                                 = "GPIO_LEDS";
GPIO1.associatedPins[0].assignedPort        = "PORTA";
GPIO1.associatedPins[0].assignedPortSegment = "Lower";
GPIO1.associatedPins[0].assignedPin         = "0";
GPIO1.associatedPins[0].$name               = "USER_LED_1";
GPIO1.associatedPins[0].initialValue        = "SET";

SYSCTL.powerPolicy = "STOP0";
SYSCTL.forceDefaultClkConfig = true;
SYSCTL.clockTreeEn  = true;

TIMER1.$name                       = "TIMER_0";
TIMER1.timerClkSrc                 = "LFCLK";
TIMER1.timerClkPrescale            = 9;
TIMER1.timerPeriod                 = "1.125 s";
TIMER1.event1ControllerInterruptEn = ["ZERO_EVENT"];
TIMER1.event1PublisherChannel      = 12;
TIMER1.peripheral.$assign          = "TIMG0";
