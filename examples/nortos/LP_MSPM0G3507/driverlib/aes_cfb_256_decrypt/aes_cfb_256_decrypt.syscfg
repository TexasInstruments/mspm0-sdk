// @cliArgs --device "MSPM0G350X" --package "LQFP-64(PM)" --part "Default"
// @cliArgs --board /ti/boards/LP_MSPM0G3507 --rtos nortos

/**
 * Import the modules used in this configuration.
 */
const AES    = scripting.addModule("/ti/driverlib/AES");
const SYSCTL = scripting.addModule("/ti/driverlib/SYSCTL");
const Board = scripting.addModule("/ti/driverlib/Board", {}, false);

/**
 * Write custom configuration values to the imported modules.
 */
AES.keyLength       = "DL_AES_KEY_LENGTH_256";
AES.blockCipherMode = "CFB_MODE";
AES.operationType   = "ENCRYPT";

SYSCTL.forceDefaultClkConfig = true;
SYSCTL.clockTreeEn  = true;
