// @cliArgs --device "MSPM0G350X" --package "LQFP-64(PM)" --part "Default"
// @cliArgs --board /ti/boards/LP_MSPM0G3507 --rtos nortos

/**
 * Import the modules used in this configuration.
 */
const Board = scripting.addModule("/ti/driverlib/Board");
const SYSCTL = scripting.addModule("/ti/driverlib/SYSCTL");
const ADC12  = scripting.addModule("/ti/driverlib/ADC12", {}, false);
const ADC121 = ADC12.addInstance();


/**
 * Write custom configuration values to the imported modules.
 */
ADC121.$name                      = "ADC12_0";
ADC121.repeatMode                 = true;
ADC121.powerDownMode              = "DL_ADC12_POWER_DOWN_MODE_MANUAL";
ADC121.enableFIFO                 = true;
ADC121.configureDMA               = true;
ADC121.sampCnt                    = 6;
ADC121.enabledDMATriggers         = ["DL_ADC12_DMA_MEM10_RESULT_LOADED"];
ADC121.resolution                 = "DL_ADC12_SAMP_CONV_RES_8_BIT";
ADC121.sampleTime0                = "125 ns";
ADC121.enabledInterrupts          = ["DL_ADC12_INTERRUPT_DMA_DONE","DL_ADC12_INTERRUPT_UNDERFLOW"];
ADC121.adcMem0chansel             = "DL_ADC12_INPUT_CHAN_2";
ADC121.peripheral.$assign         = "ADC0";
ADC121.peripheral.adcPin2.$assign = "PA25";
ADC121.DMA_CHANNEL.peripheral.$assign = "DMA_CH0";
ADC121.DMA_CHANNEL.$name          = "DMA_CH0";
ADC121.DMA_CHANNEL.addressMode    = "f2b";
SYSCTL.forceDefaultClkConfig = true;
SYSCTL.clockTreeEn  = true;
