// @cliArgs --device "MSPM0G350X" --package "LQFP-64(PM)" --part "Default"
// @cliArgs --board /ti/boards/LP_MSPM0G3507 --rtos nortos

/**
 * Import the modules used in this configuration.
 */
const Board  = scripting.addModule("/ti/driverlib/Board");
const OPA    = scripting.addModule("/ti/driverlib/OPA", {}, false);
const OPA1   = OPA.addInstance();
const SYSCTL = scripting.addModule("/ti/driverlib/SYSCTL");

/**
 * Write custom configuration values to the imported modules.
 */

OPA1.$name                     = "OPA_0";
OPA1.cfg0OutputPin             = "ENABLED";
OPA1.advRRI                    = true;
OPA1.cfg0PSELChannel           = "IN0_POS";
OPA1.cfg0NSELChannel           = "IN1_NEG";
OPA1.peripheral.$assign        = "OPA1";
OPA1.peripheral.OutPin.$assign = "PA16";

SYSCTL.forceDefaultClkConfig = true;
SYSCTL.clockTreeEn  = true;
