// @cliArgs --device "MSPM0G350X" --package "LQFP-64(PM)" --part "Default"
// @cliArgs --board /ti/boards/LP_MSPM0G3507 --rtos nortos

/**
 * Import the modules used in this configuration.
 */
const ProjectConfig = scripting.addModule("/ti/project_config/ProjectConfig");
const NONMAIN = scripting.addModule("/ti/driverlib/NONMAIN");

/**
 * Write custom configuration values to the imported modules.
 */
ProjectConfig.genDisable = true;

NONMAIN.staticWriteProtectionMainLow = 0xFFFFF00F;
NONMAIN.staticWriteProtectionNonMain = true;
NONMAIN.bslFlashPluginEnable         = true;
NONMAIN.bslPluginType                = "bslPluginUART";
NONMAIN.bslPluginHookInit            = "BSL_PI_UART_init";
NONMAIN.bslPluginHookInitAddress     = 0x1000;
NONMAIN.bslPluginHookReceive         = "BSL_PI_UART_receive";
NONMAIN.bslPluginHookReceiveAddress  = 0x1100;
NONMAIN.bslPluginHookTransmit        = "BSL_PI_UART_send";
NONMAIN.bslPluginHookTransmitAddress = 0x1300;
NONMAIN.bslPluginHookDeInit          = "BSL_PI_UART_deinit";
NONMAIN.bslPluginHookDeInitAddress   = 0x1400;
NONMAIN.nonmainWarning = true;
