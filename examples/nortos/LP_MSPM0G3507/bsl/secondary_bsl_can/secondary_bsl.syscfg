// @cliArgs --device "MSPM0G350X" --package "LQFP-64(PM)" --part "Default"
// @cliArgs --board /ti/boards/LP_MSPM0G3507 --rtos nortos

/**
 * Import the modules used in this configuration.
 */
const NONMAIN       = scripting.addModule("/ti/driverlib/NONMAIN");
const ProjectConfig = scripting.addModule("/ti/project_config/ProjectConfig");

/**
 * Write custom configuration values to the imported modules.
 */
NONMAIN.bslAltConfig                 = true;
NONMAIN.bslAltAddress                = 0x1041;
NONMAIN.nonmainWarning               = true;
NONMAIN.staticWriteProtectionMainLow = 0xFFFFC00F;

ProjectConfig.genLinker  = false;
ProjectConfig.genStartup = false;
