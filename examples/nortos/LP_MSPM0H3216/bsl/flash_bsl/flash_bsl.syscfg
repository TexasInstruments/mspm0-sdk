//@cliArgs --device "MSPM0H3216" --package "LQFP-48(PT)" --part "Default"
//@v2CliArgs --device "MSPM0H3216" --package "LQFP-48(PT)"
// @cliArgs --board /ti/boards/LP_MSPM0H3216 --rtos nortos

/**
 * Import the modules used in this configuration.
 */
const NONMAIN       = scripting.addModule("/ti/driverlib/NONMAIN");
const ProjectConfig = scripting.addModule("/ti/project_config/ProjectConfig");

/**
 * Write custom configuration values to the imported modules.
 */
NONMAIN.nonmainWarning               = true;
NONMAIN.staticWriteProtectionMainLow = 0xFFFFFE0F;
NONMAIN.staticWriteProtectionNonMain = true;
NONMAIN.bslMode                      = true;
NONMAIN.bslAltConfig                 = true;
NONMAIN.bslAltAddress                = 0x10C1;

ProjectConfig.genLinker  = false;
ProjectConfig.genStartup = false;
ProjectConfig.genOpts    = false;
ProjectConfig.genLibs    = false;
