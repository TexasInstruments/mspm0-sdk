/**
 * @cliArgs --device "MSPM0L211X" --package "LQFP-64(PM)" --part "Default"
 */
// @cliArgs --board /ti/boards/LP_MSPM0L2117 --rtos nortos

/**
 * Import the modules used in this configuration.
 */
const NONMAIN       = scripting.addModule("/ti/driverlib/NONMAIN");
const ProjectConfig = scripting.addModule("/ti/project_config/ProjectConfig");

/**
 * Write custom configuration values to the imported modules.
 */
NONMAIN.nonmainWarning               = true;
NONMAIN.staticWriteProtectionMainLow = 0xFFFF00FF;
NONMAIN.staticWriteProtectionNonMain = true;
NONMAIN.bslAltConfig                 = true;
NONMAIN.bslAltAddress                = 0x20C1;

ProjectConfig.genLinker  = false;
ProjectConfig.genOpts    = false;
ProjectConfig.genLibs    = false;
ProjectConfig.genStartup = false;
