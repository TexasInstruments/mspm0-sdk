//@cliArgs --device "MSPM0L211X" --package "LQFP-64(PM)" --part "Default"
//@v2CliArgs --device "MSPM0L2117" --package "LQFP-64(PM)"
// @cliArgs --board /ti/boards/LP_MSPM0L2117 --rtos nortos

/**
 * Import the modules used in this configuration.
 */
const Board         = scripting.addModule("/ti/driverlib/Board");
const GPIO          = scripting.addModule("/ti/driverlib/GPIO", {}, false);
const GPIO1         = GPIO.addInstance();
const GPIO2         = GPIO.addInstance();
const GPIO3         = GPIO.addInstance();
const SYSCTL        = scripting.addModule("/ti/driverlib/SYSCTL");
const ProjectConfig = scripting.addModule("/ti/project_config/ProjectConfig");

/**
 * Write custom configuration values to the imported modules.
 */

GPIO1.$name                                 = "GPIO_LEDS";
GPIO1.associatedPins.create(2);
GPIO1.associatedPins[0].$name               = "USER_LED_1";
GPIO1.associatedPins[0].assignedPin         = "0";
GPIO1.associatedPins[0].assignedPortSegment = "Lower";
GPIO1.associatedPins[1].$name               = "USER_LED_2";
GPIO1.associatedPins[1].assignedPin         = "1";
GPIO1.associatedPins[1].pin.$assign         = "PB1";

GPIO2.$name                             = "GPIO_SWITCH";
GPIO2.port                          = "PORTA";
GPIO2.associatedPins[0].$name       = "USER_SWITCH_1";
GPIO2.associatedPins[0].direction   = "INPUT";
GPIO2.associatedPins[0].assignedPin = "18";
GPIO2.associatedPins[0].polarity    = "RISE";
GPIO2.associatedPins[0].wakeupLogic = "ON_1";

GPIO3.$name                              = "GPIO_INPUT";
GPIO3.port                               = "PORTB";
GPIO3.associatedPins.create(2);
GPIO3.associatedPins[0].direction        = "INPUT";
GPIO3.associatedPins[0].assignedPin      = "16";
GPIO3.associatedPins[0].internalResistor = "PULL_UP";
GPIO3.associatedPins[0].$name            = "CONFIG_0";
GPIO3.associatedPins[1].direction        = "INPUT";
GPIO3.associatedPins[1].assignedPin      = "15";
GPIO3.associatedPins[1].internalResistor = "PULL_UP";
GPIO3.associatedPins[1].$name            = "CONFIG_1";

SYSCTL.clockTreeEn           = true;
SYSCTL.forceDefaultClkConfig = true;
