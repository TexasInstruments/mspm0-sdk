//@cliArgs --device "MSPM0L211X" --package "LQFP-64(PM)" --part "Default"
//@v2CliArgs --device "MSPM0L2117" --package "LQFP-64(PM)"
// @cliArgs --board /ti/boards/LP_MSPM0L2117 --rtos nortos

/**
 * Import the modules used in this configuration.
 */
const AESADV = scripting.addModule("/ti/driverlib/AESADV");
const DMA    = scripting.addModule("/ti/driverlib/DMA");
const SYSCTL = scripting.addModule("/ti/driverlib/SYSCTL");

/**
 * Write custom configuration values to the imported modules.
 */
const Board = scripting.addModule("/ti/driverlib/Board", {}, false);

DMA.associatedChannels.create(2);
DMA.associatedChannels[0].triggerSelect   = "AES";
DMA.associatedChannels[0].srcIncrement    = "INCREMENT";
DMA.associatedChannels[0].enableInterrupt = true;
DMA.associatedChannels[0].$name           = "DMA_CH1";
DMA.associatedChannels[0].triggerNumber   = "DMA_AESADV_AES_1_TRIG";
DMA.associatedChannels[0].addressMode     = "f2b";
DMA.associatedChannels[1].triggerSelect   = "AES";
DMA.associatedChannels[1].destIncrement   = "INCREMENT";
DMA.associatedChannels[1].enableInterrupt = true;
DMA.associatedChannels[1].$name           = "DMA_CH0";
DMA.associatedChannels[1].addressMode     = "b2f";

SYSCTL.clockTreeEn           = true;
SYSCTL.forceDefaultClkConfig = true;
