//@cliArgs --device "MSPM0G518X" --package "LQFP-64(PM)" --part "Default"
//@v2CliArgs --device "MSPM0G5187" --package "LQFP-64(PM)"
// @cliArgs --board /ti/boards/LP_MSPM0G5187 --rtos nortos

/**
 * Import the modules used in this configuration.
 */
const ProjectConfig = scripting.addModule("/ti/project_config/ProjectConfig");
const AESADV        = scripting.addModule("/ti/driverlib/AESADV");
const Board         = scripting.addModule("/ti/driverlib/Board", {}, false);
const NONMAIN       = scripting.addModule("/ti/driverlib/NONMAIN");
const SECCONFIG     = scripting.addModule("/ti/driverlib/SECCONFIG");
const GPIO          = scripting.addModule("/ti/driverlib/GPIO", {}, false);
const GPIO1         = GPIO.addInstance();
const GPIO2         = GPIO.addInstance();
const SYSCTL        = scripting.addModule("/ti/driverlib/SYSCTL", {}, false);

/**
 * Write custom configuration values to the imported modules.
 */
ProjectConfig.genDisable = true;

NONMAIN.nonmainWarning = true;
NONMAIN.cscExists      = true;
NONMAIN.flashBankSwap  = true;

SECCONFIG.cscPrereqAck        = true;
SECCONFIG.developmentOptions  = ["enablePseudoRandom"];
SECCONFIG.cscBankSize         = 0x10000;
SECCONFIG.cscSecretAddress    = 0x4000;
SECCONFIG.cscSecretSize       = 0x400;
SECCONFIG.cscLockStorageSize  = 0x400;
SECCONFIG.cscAppImageBaseAddr = 0x4800;
SECCONFIG.cscAppImageSize     = 0x2800;

GPIO1.$name                         = "GPIO_LEDS";
GPIO1.associatedPins.create(1);
GPIO1.associatedPins[0].$name       = "USER_LED_RED";
GPIO1.associatedPins[0].pin.$assign = "PA17";
