//@cliArgs --device "MSPM0G518X" --package "LQFP-64(PM)" --part "Default"
//@v2CliArgs --device "MSPM0G5187" --package "LQFP-64(PM)"
// @cliArgs --board /ti/boards/LP_MSPM0G5187 --rtos nortos

/**
 * Import the modules used in this configuration.
 */
const SYSCTL  = scripting.addModule("/ti/driverlib/SYSCTL");
const SYSTICK = scripting.addModule("/ti/driverlib/SYSTICK");
const UART    = scripting.addModule("/ti/driverlib/UART", {}, false);
const UART1   = UART.addInstance();
const tinyusb = scripting.addModule("/ti/tinyusb_meta/tinyusb");

/**
 * Write custom configuration values to the imported modules.
 */
const divider6       = system.clockTree["PLL_CLK2X_DIV"];
divider6.divideValue = 3;

const divider9       = system.clockTree["UDIV"];
divider9.divideValue = 2;

const multiplier2         = system.clockTree["PLL_QDIV"];
multiplier2.multiplyValue = 3;

const mux3       = system.clockTree["EXHFMUX"];
mux3.inputSelect = "EXHFMUX_XTAL";

const mux7       = system.clockTree["HSCLKMUX"];
mux7.inputSelect = "HSCLKMUX_SYSPLL2X";

const mux11       = system.clockTree["SYSPLLMUX"];
mux11.inputSelect = "zSYSPLLMUX_HFCLK";

const mux13       = system.clockTree["USBCLKMUX"];
mux13.inputSelect = "USBCLKMUX_PLLCLK1_OUT";

const pinFunction3     = system.clockTree["HFCLKEXT"];
pinFunction3.inputFreq = 40;
pinFunction3.enable    = true;

const pinFunction4        = system.clockTree["HFXT"];
pinFunction4.inputFreq    = 40;
pinFunction4.enable       = true;
pinFunction4.HFCLKMonitor = true;

SYSCTL.forceDefaultClkConfig = true;
SYSCTL.clockTreeEn           = true;
SYSCTL.SYSPLLSource          = "HFCLK";
SYSCTL.useHFCLK_Manual       = true;
SYSCTL.HFCLKSource           = "HFXT";
SYSCTL.HFCLK_Freq            = 40000000;
SYSCTL.SYSPLL_Pdiv           = 1;
SYSCTL.SYSPLL_Qdiv           = 3;
SYSCTL.SYSPLL_CLK2XEn        = true;
SYSCTL.SYSPLL_CLK1En         = true;
SYSCTL.SYSPLL_CLK2XDiv       = 2;
scripting.suppress("For best practices when the CPUCLK is running at 32MHz and above, clear the flash status bit using DL_FlashCTL_executeClearStatus\\(\\) before executing any flash operation\\. Otherwise there may be false positives\\.", SYSCTL);

const Board = scripting.addModule("/ti/driverlib/Board", {}, false);

SYSTICK.periodEnable    = true;
SYSTICK.interruptEnable = true;
SYSTICK.systickEnable   = true;
SYSTICK.period          = 80000;

tinyusb.mode                                                     = "host";
tinyusb.associated_USB.$name                                     = "USB_0";
tinyusb.associatedGPIO_LED.$name                                 = "GPIO_GRP_0";
tinyusb.associatedGPIO_LED.port                                  = "PORTA";
tinyusb.associatedGPIO_LED.portSegment                           = "Upper";
tinyusb.associatedGPIO_LED.associatedPins[0].$name               = "PIN_0";
tinyusb.associatedGPIO_LED.associatedPins[0].assignedPin         = "24";
tinyusb.associatedGPIO_BUTTON.$name                              = "GPIO_GRP_1";
tinyusb.associatedGPIO_BUTTON.port                               = "PORTA";
tinyusb.associatedGPIO_BUTTON.portSegment                        = "Lower";
tinyusb.associatedGPIO_BUTTON.associatedPins[0].$name            = "PIN_1";
tinyusb.associatedGPIO_BUTTON.associatedPins[0].assignedPin      = "7";
tinyusb.associatedGPIO_BUTTON.associatedPins[0].direction        = "INPUT";
tinyusb.associatedGPIO_BUTTON.associatedPins[0].internalResistor = "PULL_UP";
tinyusb.associated_hostMSC.create(1);
tinyusb.associated_hostMSC[0].$name                              = "MSC_0";
tinyusb.associated_hostMSC[0].MSC_EP_IN_DATA.$name               = "EP_IN_0";
tinyusb.associated_hostMSC[0].MSC_EP_OUT_DATA.$name              = "EP_OUT_0";

UART1.$name             = "UART_0";
tinyusb.associatedUART  = UART1;
UART1.targetBaudRate    = 115200;
