//@cliArgs --device "MSPM0G518X" --package "LQFP-64(PM)" --part "Default"
//@v2CliArgs --device "MSPM0G5187" --package "LQFP-64(PM)"
// @cliArgs --board /ti/boards/LP_MSPM0G5187 --rtos nortos

/**
 * Import the modules used in this configuration.
 */
const SYSCTL  = scripting.addModule("/ti/driverlib/SYSCTL");
const SYSTICK = scripting.addModule("/ti/driverlib/SYSTICK");
const UART    = scripting.addModule("/ti/driverlib/UART", {}, false);
const UART1   = UART.addInstance();
const tinyusb = scripting.addModule("/ti/tinyusb_meta/tinyusb");

/**
 * Write custom configuration values to the imported modules.
 */
const divider9       = system.clockTree["UDIV"];
divider9.divideValue = 2;

const gate10           = system.clockTree["USBFLLGATE"];
gate10.enable          = true;
gate10.referenceSource = "SOF";

const multiplier2         = system.clockTree["PLL_QDIV"];
multiplier2.multiplyValue = 5;

const mux7       = system.clockTree["HSCLKMUX"];
mux7.inputSelect = "HSCLKMUX_SYSPLL0";

SYSCTL.forceDefaultClkConfig = true;
SYSCTL.clockTreeEn           = true;

const Board = scripting.addModule("/ti/driverlib/Board", {}, false);

SYSTICK.periodEnable    = true;
SYSTICK.interruptEnable = true;
SYSTICK.systickEnable   = true;
SYSTICK.period          = 80000;

tinyusb.bcdVal                                                                      = 0x201;
tinyusb.strManufacturer                                                             = "Texas Instruments";
tinyusb.strProduct                                                                  = "MSPM0 Billboard Device";
tinyusb.associated_devBillboard.create(1);
tinyusb.associated_devBillboard[0].$name                                            = "BILLBOARD_0";
tinyusb.associated_devBillboard[0].overrideDefaultStr                               = true;
tinyusb.associated_devBillboard[0].classString                                      = "MSPM0 Billboard Device";
tinyusb.associated_devBillboard[0].UUID_1                                           = 0x12;
tinyusb.associated_devBillboard[0].UUID_2                                           = 0x34;
tinyusb.associated_devBillboard[0].UUID_3                                           = 0x5A;
tinyusb.associated_devBillboard[0].UUID_4                                           = 0xF0;
tinyusb.associated_devBillboard[0].UUID_5                                           = 0xD4;
tinyusb.associated_devBillboard[0].UUID_6                                           = 0x78;
tinyusb.associated_devBillboard[0].UUID_7                                           = 0x9A;
tinyusb.associated_devBillboard[0].UUID_8                                           = 0x4A;
tinyusb.associated_devBillboard[0].UUID_9                                           = 0xBC;
tinyusb.associated_devBillboard[0].UUID_10                                          = 0xDE;
tinyusb.associated_devBillboard[0].UUID_11                                          = 0x11;
tinyusb.associated_devBillboard[0].UUID_12                                          = 0x22;
tinyusb.associated_devBillboard[0].UUID_13                                          = 0x33;
tinyusb.associated_devBillboard[0].UUID_14                                          = 0x44;
tinyusb.associated_devBillboard[0].UUID_15                                          = 0x55;
tinyusb.associated_devBillboard[0].UUID_16                                          = 0x66;
tinyusb.associated_devBillboard[0].associated_devBillboardAUM.create(3);
tinyusb.associated_devBillboard[0].associated_devBillboardAUM[0].$name              = "USB4";
tinyusb.associated_devBillboard[0].associated_devBillboardAUM[0].dwAlternateModeVdo = 0x2045E000;
tinyusb.associated_devBillboard[0].associated_devBillboardAUM[0].AUMStr             = "USB4 Alternate Mode";
tinyusb.associated_devBillboard[0].associated_devBillboardAUM[0].wSVID              = 0xFF00;
tinyusb.associated_devBillboard[0].associated_devBillboardAUM[1].$name              = "DISPLAYPORT";
tinyusb.associated_devBillboard[0].associated_devBillboardAUM[1].wSVID              = 0xFF01;
tinyusb.associated_devBillboard[0].associated_devBillboardAUM[1].AUMStr             = "DisplayPort Alternate Mode";
tinyusb.associated_devBillboard[0].associated_devBillboardAUM[1].dwAlternateModeVdo = 0x20C05;
tinyusb.associated_devBillboard[0].associated_devBillboardAUM[2].$name              = "THUNDERBOLT";
tinyusb.associated_devBillboard[0].associated_devBillboardAUM[2].wSVID              = 0x8087;
tinyusb.associated_devBillboard[0].associated_devBillboardAUM[2].AUMStr             = "Thunderbolt Alternate Mode";
tinyusb.associated_devBillboard[0].associated_devBillboardAUM[2].dwAlternateModeVdo = 0x2;
tinyusb.associated_USB.$name                                                        = "USB_0";
tinyusb.associatedGPIO_LED.$name                                                    = "GPIO_GRP_0";
tinyusb.associatedGPIO_LED.port                                                     = "PORTA";
tinyusb.associatedGPIO_LED.portSegment                                              = "Upper";
tinyusb.associatedGPIO_LED.associatedPins[0].$name                                  = "PIN_0";
tinyusb.associatedGPIO_LED.associatedPins[0].assignedPin                            = "24";
tinyusb.associatedGPIO_BUTTON.$name                                                 = "GPIO_GRP_1";
tinyusb.associatedGPIO_BUTTON.port                                                  = "PORTA";
tinyusb.associatedGPIO_BUTTON.portSegment                                           = "Lower";
tinyusb.associatedGPIO_BUTTON.associatedPins[0].$name                               = "PIN_1";
tinyusb.associatedGPIO_BUTTON.associatedPins[0].direction                           = "INPUT";
tinyusb.associatedGPIO_BUTTON.associatedPins[0].internalResistor                    = "PULL_UP";
tinyusb.associatedGPIO_BUTTON.associatedPins[0].assignedPin                         = "7";

UART1.$name             = "UART_0";
tinyusb.associatedUART  = UART1;
UART1.targetBaudRate    = 115200;
