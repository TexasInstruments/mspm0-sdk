// @cliArgs --device "MSPM0G518X" --part "Default" --package "LQFP-64(PM)" 
// @v2CliArgs --device "MSPM0G5187" --package "LQFP-64(PM)"
// @cliArgs --board /ti/boards/LP_MSPM0G5187 --rtos nortos

/**
 * Import the modules used in this configuration.
 */
const NONMAIN       = scripting.addModule("/ti/driverlib/NONMAIN");
const ProjectConfig = scripting.addModule("/ti/project_config/ProjectConfig");

/**
 * Write custom configuration values to the imported modules.
 */
NONMAIN.nonmainWarning               = true;
NONMAIN.staticWriteProtectionNonMain = true;
NONMAIN.staticWriteProtectionMainLow = 0xFFFF00FF;
NONMAIN.bslAltConfig                 = true;
NONMAIN.bslAltAddress                = 0x20C1;

ProjectConfig.genLinker  = false;
ProjectConfig.genLibs    = false;
ProjectConfig.genOpts    = false;
ProjectConfig.genStartup = false;
