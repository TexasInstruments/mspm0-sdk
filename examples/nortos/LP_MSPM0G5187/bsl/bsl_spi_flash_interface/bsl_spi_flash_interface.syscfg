// @cliArgs --device "MSPM0G518X" --part "Default" --package "LQFP-64(PM)" 
// @v2CliArgs --device "MSPM0G5187" --package "LQFP-64(PM)"
// @cliArgs --board /ti/boards/LP_MSPM0G5187 --rtos nortos

/**
 * Import the modules used in this configuration.
 */
const NONMAIN       = scripting.addModule("/ti/driverlib/NONMAIN");
const ProjectConfig = scripting.addModule("/ti/project_config/ProjectConfig");

/**
 * Write custom configuration values to the imported modules.
 */
NONMAIN.nonmainWarning               = true;
NONMAIN.bslFlashPluginEnable         = true;
NONMAIN.bslPluginHookInitAddress     = 0x2000;
NONMAIN.bslPluginHookReceiveAddress  = 0x2100;
NONMAIN.bslPluginHookTransmitAddress = 0x2300;
NONMAIN.bslPluginHookDeInitAddress   = 0x2400;
NONMAIN.bslPluginHookInit            = "BSL_PI_SPI_init";
NONMAIN.bslPluginHookReceive         = "BSL_PI_SPI_receive";
NONMAIN.bslPluginHookTransmit        = "BSL_PI_SPI_send";
NONMAIN.bslPluginHookDeInit          = "BSL_PI_SPI_deinit";
NONMAIN.staticWriteProtectionNonMain = true;
NONMAIN.staticWriteProtectionMainLow = 0xFFFF00FF;

ProjectConfig.genLinker = false;
ProjectConfig.genLibs   = false;
ProjectConfig.genOpts   = false;
