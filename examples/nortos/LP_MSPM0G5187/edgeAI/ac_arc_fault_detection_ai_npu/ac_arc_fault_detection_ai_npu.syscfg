//@cliArgs --device "MSPM0G518X" --package "LQFP-64(PM)" --part "Default"
//@v2CliArgs --device "MSPM0G5187" --package "LQFP-64(PM)"
// @cliArgs --board /ti/boards/LP_MSPM0G5187 --rtos nortos

/**
 * Import the modules used in this configuration.
 */
const ADC12         = scripting.addModule("/ti/driverlib/ADC12", {}, false);
const ADC121        = ADC12.addInstance();
const GPIO          = scripting.addModule("/ti/driverlib/GPIO", {}, false);
const GPIO1         = GPIO.addInstance();
const SYSCTL        = scripting.addModule("/ti/driverlib/SYSCTL");
const ProjectConfig = scripting.addModule("/ti/project_config/ProjectConfig");

/**
 * Write custom configuration values to the imported modules.
 */
const divider9       = system.clockTree["UDIV"];
divider9.divideValue = 2;

const multiplier2         = system.clockTree["PLL_QDIV"];
multiplier2.multiplyValue = 5;

const mux7       = system.clockTree["HSCLKMUX"];
mux7.inputSelect = "HSCLKMUX_SYSPLL0";

ADC121.$name                            = "ADC12_0";
ADC121.repeatMode                       = true;
ADC121.adcMem0chansel                   = "DL_ADC12_INPUT_CHAN_8";
ADC121.powerDownMode                    = "DL_ADC12_POWER_DOWN_MODE_MANUAL";
ADC121.hwNumerator                      = "DL_ADC12_HW_AVG_NUM_ACC_4";
ADC121.enabledInterrupts                = ["DL_ADC12_INTERRUPT_DMA_DONE"];
ADC121.configureDMA                     = true;
ADC121.enableFIFO                       = true;
ADC121.sampleTime0                      = "9.3 us";
ADC121.sampCnt                          = 6;
ADC121.enabledDMATriggers               = ["DL_ADC12_DMA_MEM11_RESULT_LOADED"];
ADC121.peripheral.$assign               = "ADC0";
ADC121.peripheral.adcPin8.$assign       = "PA21";
ADC121.DMA_CHANNEL.$name                = "DMA_CH0";
ADC121.DMA_CHANNEL.addressMode          = "f2b";
ADC121.DMA_CHANNEL.enableInterrupt      = true;
ADC121.DMA_CHANNEL.earlyIntThresh       = "HALF";
ADC121.DMA_CHANNEL.enableEarlyInterrupt = true;

const Board = scripting.addModule("/ti/driverlib/Board", {}, false);

GPIO1.$name                         = "GPIO_GRP_0";
GPIO1.associatedPins[0].$name       = "PIN_0";
GPIO1.associatedPins[0].pin.$assign = "PA31";

SYSCTL.forceDefaultClkConfig = true;
SYSCTL.clockTreeEn           = true;

ProjectConfig.migrationCondition = true;
ProjectConfig.genLibNPU          = true;
ProjectConfig.genLibCMSIS        = true;
