//@cliArgs --device "MSPM0G511X" --package "LQFP-64(PM)" --part "Default"
//@v2CliArgs --device "MSPM0G5117" --package "LQFP-64(PM)"
// @cliArgs --board /ti/boards/LP_MSPM0G5187 --rtos nortos

/**
 * Import the modules used in this configuration.
 */
const GPIO    = scripting.addModule("/ti/driverlib/GPIO", {}, false);
const GPIO1   = GPIO.addInstance();
const TIMERB  = scripting.addModule("/ti/driverlib/TIMERB", {}, false);
const TIMERB1 = TIMERB.addInstance();

/**
 * Write custom configuration values to the imported modules.
 */
GPIO1.$name                          = "GPIO_LEDS";
GPIO1.associatedPins[0].$name        = "USER_LED";
GPIO1.associatedPins[0].assignedPin  = "0";
GPIO1.associatedPins[0].assignedPort = "PORTA";

const Board = scripting.addModule("/ti/driverlib/Board", {}, false);

const SYSCTL = scripting.addModule("/ti/driverlib/SYSCTL", {}, false);

TIMERB1.$name                            = "TIMERB0";
TIMERB1.enabledInterrupts                = ["CNT1_OVF_EVENT"];
TIMERB1.associatedTimer.create(2);
TIMERB1.associatedTimer[0].$name         = "COUNTER_0";
TIMERB1.associatedTimer[0].startCounter  = true;
TIMERB1.associatedTimer[0].desiredPeriod = "1 ms";
TIMERB1.associatedTimer[1].$name         = "COUNTER_1";
TIMERB1.associatedTimer[1].clockSource   = "CNT0_OVERFLOW";
TIMERB1.associatedTimer[1].userLoadValue = 1000;
TIMERB1.associatedTimer[1].startCounter  = true;
