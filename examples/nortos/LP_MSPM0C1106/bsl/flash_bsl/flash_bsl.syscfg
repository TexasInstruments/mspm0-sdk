//@cliArgs --device "MSPM0C1105_C1106" --package "VQFN-48(RGZ)" --part "Default"
//@v2CliArgs --device "MSPM0C1106" --package "VQFN-48(RGZ)"
// @cliArgs --board /ti/boards/LP_MSPM0C1106 --rtos nortos

/**
 * Import the modules used in this configuration.
 */
const NONMAIN       = scripting.addModule("/ti/driverlib/NONMAIN");
const ProjectConfig = scripting.addModule("/ti/project_config/ProjectConfig");

/**
 * Write custom configuration values to the imported modules.
 */
NONMAIN.nonmainWarning               = true;
NONMAIN.staticWriteProtectionNonMain = true;
NONMAIN.bslMode                      = true;
NONMAIN.bslAltConfig                 = true;
NONMAIN.bslAltAddress                = 0x20C1;
NONMAIN.staticWriteProtectionMainLow = 0xFFFF00FF;

ProjectConfig.genLinker  = false;
ProjectConfig.genStartup = false;
ProjectConfig.genOpts    = false;
ProjectConfig.genLibs    = false;
