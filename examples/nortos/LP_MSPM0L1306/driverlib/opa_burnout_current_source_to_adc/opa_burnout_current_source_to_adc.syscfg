// @cliArgs --device "MSPM0L130X" --package "VQFN-32(RHB)" --part "Default"
// @cliArgs --board /ti/boards/LP_MSPM0L1306 --rtos nortos

/**
 * Import the modules used in this configuration.
 */
const ADC12  = scripting.addModule("/ti/driverlib/ADC12", {}, false);
const ADC121 = ADC12.addInstance();
const OPA    = scripting.addModule("/ti/driverlib/OPA", {}, false);
const OPA1   = OPA.addInstance();
const SYSCTL = scripting.addModule("/ti/driverlib/SYSCTL");

/**
 * Write custom configuration values to the imported modules.
 */
ADC121.$name             = "ADC12_0";
ADC121.sampClkDiv        = "DL_ADC12_CLOCK_DIVIDE_8";
ADC121.adcMem0chansel    = "DL_ADC12_INPUT_CHAN_7";
ADC121.adcMem0bcsen      = true;
ADC121.sampleTime0       = "125 us";
ADC121.enabledInterrupts = ["DL_ADC12_INTERRUPT_MEM0_RESULT_LOADED"];

const Board = scripting.addModule("/ti/driverlib/Board", {}, false);

OPA1.$name           = "OPA_0";
OPA1.cfg0PSELChannel = "IN0_POS";
OPA1.cfg0NSELChannel = "RTOP";
OPA1.advBW           = "HIGH";

SYSCTL.clockTreeEn = true;
