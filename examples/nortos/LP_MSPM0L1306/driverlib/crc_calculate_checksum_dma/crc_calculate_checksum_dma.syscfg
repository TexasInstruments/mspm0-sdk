// @cliArgs --device "MSPM0L130X" --package "VQFN-32(RHB)" --part "Default"
// @cliArgs --board /ti/boards/LP_MSPM0L1306 --rtos nortos

/**
 * Import the modules used in this configuration.
 */
const Board       = scripting.addModule("/ti/driverlib/Board");
const CRC         = scripting.addModule("/ti/driverlib/CRC");
const SYSCTL      = scripting.addModule("/ti/driverlib/SYSCTL");

/**
 * Write custom configuration values to the imported modules.
 */

CRC.seed   = 0xFFFFFFFF;
CRC.enableCRCCalcWithDMA  = true;
CRC.DMA_CHANNEL_CRC.$name = "DMA_CH0";
CRC.DMA_CHANNEL_CRC.enableInterrupt = true;
CRC.DMA_CHANNEL_CRC.peripheral.$assign  = "DMA_CH0";

SYSCTL.clockTreeEn = true;
