// @cliArgs --device "MSPM0L130X" --package "VQFN-32(RHB)" --part "Default"
// @cliArgs --board /ti/boards/LP_MSPM0L1306 --rtos nortos

/**
 * Import the modules used in this configuration.
 */
const ADC12  = scripting.addModule("/ti/driverlib/ADC12", {}, false);
const ADC121 = ADC12.addInstance();
const GPAMP  = scripting.addModule("/ti/driverlib/GPAMP", {}, false);
const GPAMP1 = GPAMP.addInstance();
const SYSCTL = scripting.addModule("/ti/driverlib/SYSCTL");

/**
 * Write custom configuration values to the imported modules.
 */
const oscillator2           = system.clockTree["SYSOSC"];
oscillator2.frequencySelect = 4;

ADC121.$name              = "ADC12_0";
ADC121.adcMem0chansel     = "DL_ADC12_INPUT_CHAN_7";
ADC121.sampleTime0        = "1ms";
ADC121.enabledInterrupts  = ["DL_ADC12_INTERRUPT_MEM0_RESULT_LOADED"];
ADC121.sampClkDiv         = "DL_ADC12_CLOCK_DIVIDE_8";
ADC121.peripheral.$assign = "ADC0";

const Board = scripting.addModule("/ti/driverlib/Board", {}, false);

GPAMP1.$name           = "GPAMP_0";
GPAMP1.cfgChoppingFreq = "2KHZ";
GPAMP1.cfgPSELChannel  = "IN_POS";
GPAMP1.advRRI          = "RAIL_TO_RAIL";
GPAMP1.cfgNSELChannel  = "OUTPUT_PIN";

SYSCTL.SYSOSC_Freq = 4000000;
SYSCTL.clockTreeEn = true;
