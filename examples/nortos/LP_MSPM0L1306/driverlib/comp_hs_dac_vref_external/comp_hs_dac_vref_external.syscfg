// @cliArgs --device "MSPM0L130X" --package "VQFN-32(RHB)" --part "Default"
// @cliArgs --board /ti/boards/LP_MSPM0L1306 --rtos nortos

/**
 * Import the modules used in this configuration.
 */
const Board  = scripting.addModule("/ti/driverlib/Board");
const COMP   = scripting.addModule("/ti/driverlib/COMP", {}, false);
const COMP1  = COMP.addInstance();
const GPIO   = scripting.addModule("/ti/driverlib/GPIO", {}, false);
const GPIO1  = GPIO.addInstance();
const SYSCTL = scripting.addModule("/ti/driverlib/SYSCTL");
const VREF   = scripting.addModule("/ti/driverlib/VREF");

/**
 * Write custom configuration values to the imported modules.
 */
Board.InitPriority8 = "/ti/driverlib/VREF";

COMP1.selectOutputFilter             = "DL_COMP_FILTER_DELAY_1200";
COMP1.enableOutputFilter             = true;
COMP1.channelEnable                  = ["NEG"];
COMP1.hysteresis                     = "DL_COMP_HYSTERESIS_30";
COMP1.controlSelect                  = "DL_COMP_DAC_CONTROL_SW";
COMP1.enabledInterrupts              = ["DL_COMP_INTERRUPT_OUTPUT_EDGE","DL_COMP_INTERRUPT_OUTPUT_EDGE_INV"];
COMP1.$name                          = "COMP";
COMP1.vSource                        = "DL_COMP_REF_SOURCE_VDDA_DAC";
COMP1.peripheral.$assign             = "COMP0";
COMP1.peripheral.compPinNeg0.$assign = "PA27";

GPIO1.$name                         = "GPIO_LEDS";
GPIO1.port                          = "PORTA";
GPIO1.portSegment                   = "Lower";
GPIO1.associatedPins[0].$name       = "USER_LED_1";
GPIO1.associatedPins[0].assignedPin = "0";
GPIO1.associatedPins[0].initialValue        = "SET";
GPIO1.associatedPins[0].pin.$assign = "PA0";


VREF.basicIntVolt                  = "DL_VREF_BUFCONFIG_OUTPUT_2_5V";
VREF.advClockConfigEnable          = true;
VREF.advClkSrc                     = "DL_VREF_CLOCK_BUSCLK";
VREF.basicVrefPins                 = "VREF+-";
VREF.checkVREFReady                = true;
VREF.peripheral.$assign            = "VREF";

SYSCTL.clockTreeEn = true;
