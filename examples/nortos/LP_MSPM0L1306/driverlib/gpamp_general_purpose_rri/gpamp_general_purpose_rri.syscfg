// @cliArgs --device "MSPM0L130X" --package "VQFN-32(RHB)" --part "Default"
// @cliArgs --board /ti/boards/LP_MSPM0L1306 --rtos nortos

/**
 * Import the modules used in this configuration.
 */
const GPAMP  = scripting.addModule("/ti/driverlib/GPAMP", {}, false);
const GPAMP1 = GPAMP.addInstance();

/**
 * Write custom configuration values to the imported modules.
 */
GPAMP1.$name           = "GPAMP_0";
GPAMP1.cfgChoppingFreq = "2KHZ";
GPAMP1.cfgNSELChannel  = "IN_NEG";
GPAMP1.cfgPSELChannel  = "IN_POS";
GPAMP1.cfgOutputPin    = "ENABLED";
GPAMP1.advRRI          = "RAIL_TO_RAIL";

const Board = scripting.addModule("/ti/driverlib/Board", {}, false);

const SYSCTL = scripting.addModule("/ti/driverlib/SYSCTL", {}, false);
SYSCTL.clockTreeEn = true;
