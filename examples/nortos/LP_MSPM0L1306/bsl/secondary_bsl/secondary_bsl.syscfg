// @cliArgs --device "MSPM0L130X" --package "VQFN-32(RHB)" --part "Default"
// @cliArgs --board /ti/boards/LP_MSPM0L1306 --rtos nortos

/**
 * Import the modules used in this configuration.
 */
const ProjectConfig = scripting.addModule("/ti/project_config/ProjectConfig");
const NONMAIN = scripting.addModule("/ti/driverlib/NONMAIN");

/**
 * Write custom configuration values to the imported modules.
 */
ProjectConfig.genDisable = true;

NONMAIN.staticWriteProtectionMainLow = 0xFFFFF00F;
NONMAIN.staticWriteProtectionNonMain = true;
NONMAIN.bslAltConfig                 = true;
NONMAIN.bslAltAddress                = 0x00001041;
NONMAIN.nonmainWarning = true;
