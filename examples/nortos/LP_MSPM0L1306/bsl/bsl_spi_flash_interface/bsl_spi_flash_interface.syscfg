// @cliArgs --device "MSPM0L130X" --package "VQFN-32(RHB)" --part "Default"
// @cliArgs --board /ti/boards/LP_MSPM0L1306 --rtos nortos

/**
 * Import the modules used in this configuration.
 */
const ProjectConfig = scripting.addModule("/ti/project_config/ProjectConfig");
const NONMAIN = scripting.addModule("/ti/driverlib/NONMAIN");

/**
 * Write custom configuration values to the imported modules.
 */
ProjectConfig.genDisable = true;

NONMAIN.bslFlashPluginEnable         = true;
NONMAIN.staticWriteProtectionMainLow = 0xFFFFFF0F;
NONMAIN.bslPluginHookInit            = "BSL_PI_SPI_init";
NONMAIN.bslPluginHookReceive         = "BSL_PI_SPI_receive";
NONMAIN.bslPluginHookTransmit        = "BSL_PI_SPI_send";
NONMAIN.bslPluginHookDeInit          = "BSL_PI_SPI_deinit";
NONMAIN.bslPluginHookInitAddress     = 0x1000;
NONMAIN.bslPluginHookReceiveAddress  = 0x1100;
NONMAIN.bslPluginHookTransmitAddress = 0x1300;
NONMAIN.bslPluginHookDeInitAddress   = 0x1400;
NONMAIN.nonmainWarning = true;
