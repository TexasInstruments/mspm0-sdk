/**
 * @cliArgs --device "MSPM0L222X" --part "Default" --package "LQFP-80(PN)"
 */
// @cliArgs --board /ti/boards/LP_MSPM0L2228 --rtos nortos

/**
 * Import the modules used in this configuration.
 */
const AESADV        = scripting.addModule("/ti/driverlib/AESADV");
const Board         = scripting.addModule("/ti/driverlib/Board");
const EVENT         = scripting.addModule("/ti/driverlib/EVENT");
const NONMAIN       = scripting.addModule("/ti/driverlib/NONMAIN");
const SECCONFIG     = scripting.addModule("/ti/driverlib/SECCONFIG");
const SYSCTL        = scripting.addModule("/ti/driverlib/SYSCTL");
const ProjectConfig = scripting.addModule("/ti/project_config/ProjectConfig");

/**
 * Write custom configuration values to the imported modules.
 */

NONMAIN.nonmainWarning = true;
NONMAIN.cscExists      = true;

SECCONFIG.cscPrereqAck                = true;
SECCONFIG.enableCMACAcceleration      = false;
SECCONFIG.enableRollbackProtection    = false;
SECCONFIG.enableStaticSharedSecretKey = false;
SECCONFIG.enableIPProtection          = false;
SECCONFIG.exposeSecurityPrimitives    = false;
SECCONFIG.cscBankSize                 = 131072;
SECCONFIG.cscSecretAddress            = 0x4000;
SECCONFIG.cscSecretSize               = 1024;
SECCONFIG.cscLockStorageSize          = 1024;
SECCONFIG.cscAppImageBaseAddr         = 0x4800;
SECCONFIG.cscAppImageSize             = 10240;

SYSCTL.clockTreeEn           = true;
SYSCTL.forceDefaultClkConfig = true;

ProjectConfig.deviceSpin = "MSPM0L2228";
ProjectConfig.genLinker  = false;

/**
 * These are the reserved peripherals and settings in this configuration
 */
const iTRNG1   = scripting.addPeripheral("TRNG");
iTRNG1.$name   = "MyTRNG1";
iTRNG1.$assign = "TRNG";
