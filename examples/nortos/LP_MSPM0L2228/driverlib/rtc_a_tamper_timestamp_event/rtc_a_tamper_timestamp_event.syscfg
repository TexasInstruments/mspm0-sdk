// @cliArgs --device "MSPM0L222X" --package "LQFP-80(PN)" --part "Default"
// @cliArgs --board /ti/boards/LP_MSPM0L2228 --rtos nortos

/**
 * Import the modules used in this configuration.
 */
const Board         = scripting.addModule("/ti/driverlib/Board");
const GPIO          = scripting.addModule("/ti/driverlib/GPIO", {}, false);
const GPIO1         = GPIO.addInstance();
const RTCA          = scripting.addModule("/ti/driverlib/RTCA");
const TAMPERIO      = scripting.addModule("/ti/driverlib/TAMPERIO");
const ProjectConfig = scripting.addModule("/ti/project_config/ProjectConfig");

/**
 * Write custom configuration values to the imported modules.
 */

GPIO1.$name                          = "GPIO_LEDS";
GPIO1.associatedPins[0].assignedPort = "PORTA";
GPIO1.associatedPins[0].assignedPin  = "0";
GPIO1.associatedPins[0].initialValue = "SET";
GPIO1.associatedPins[0].$name        = "USER_LED_1";

RTCA.calYear           = 2024;
RTCA.calDOW            = "1";
RTCA.timeStampEvents   = ["TIME_STAMP_EVENT_SOURCE_TIO_0"];
RTCA.tsCaptureMethod   = "TIME_STAMP_EVENT_CAPTURE_LAST";
RTCA.enabledInterrupts = ["TSEVT"];

const SYSCTL = scripting.addModule("/ti/driverlib/SYSCTL", {}, false);
SYSCTL.clockTreeEn = true;

TAMPERIO.enabletio0         = true;
TAMPERIO.tio0polarityEnable = "RISE";
