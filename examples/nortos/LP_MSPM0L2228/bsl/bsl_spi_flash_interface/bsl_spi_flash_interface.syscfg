// @cliArgs --device "MSPM0L222X" --package "LQFP-80(PN)" --part "Default"
// @v2CliArgs --device "MSPM0L2228" --package "LQFP-80(PN)"
// @cliArgs --board /ti/boards/LP_MSPM0L2228 --rtos nortos

/**
 * Import the modules used in this configuration.
 */
const NONMAIN       = scripting.addModule("/ti/driverlib/NONMAIN");
const ProjectConfig = scripting.addModule("/ti/project_config/ProjectConfig");

/**
 * Write custom configuration values to the imported modules.
 */
NONMAIN.bslFlashPluginEnable         = true;
NONMAIN.staticWriteProtectionMainLow = 0xFFFF00FF;
NONMAIN.staticWriteProtectionNonMain = true;
NONMAIN.bslPluginHookInit            = "BSL_PI_SPI_init";
NONMAIN.bslPluginHookReceive         = "BSL_PI_SPI_receive";
NONMAIN.bslPluginHookTransmit        = "BSL_PI_SPI_send";
NONMAIN.bslPluginHookDeInit          = "BSL_PI_SPI_deinit";
NONMAIN.bslPluginHookInitAddress     = 0x2000;
NONMAIN.bslPluginHookReceiveAddress  = 0x2100;
NONMAIN.bslPluginHookTransmitAddress = 0x2300;
NONMAIN.bslPluginHookDeInitAddress   = 0x2400;
NONMAIN.nonmainWarning               = true;

ProjectConfig.genDisable = true;
