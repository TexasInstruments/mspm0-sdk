//@cliArgs --device "MSPM0L111X" --package "LQFP-48(PT)" --part "Default"
//@v2CliArgs --device "MSPM0L1117" --package "LQFP-48(PT)"
// @cliArgs --board /ti/boards/LP_MSPM0L1117 --rtos nortos

/**
 * Import the modules used in this configuration.
 */
const AESADV        = scripting.addModule("/ti/driverlib/AESADV");
const Board         = scripting.addModule("/ti/driverlib/Board");
const DMA           = scripting.addModule("/ti/driverlib/DMA");
const GPIO          = scripting.addModule("/ti/driverlib/GPIO", {}, false);
const GPIO1         = GPIO.addInstance();
const ProjectConfig = scripting.addModule("/ti/project_config/ProjectConfig");

/**
 * Write custom configuration values to the imported modules.
 */
AESADV.lowerCryptoLength = 0x40;

DMA.associatedChannels.create(2);
DMA.associatedChannels[0].triggerSelect   = "AES";
DMA.associatedChannels[0].enableInterrupt = true;
DMA.associatedChannels[0].srcIncrement    = "INCREMENT";
DMA.associatedChannels[0].$name           = "DMA_CH1";
DMA.associatedChannels[0].addressMode     = "f2b";
DMA.associatedChannels[0].triggerNumber   = "DMA_AESADV_AES_1_TRIG";
DMA.associatedChannels[1].triggerSelect   = "AES";
DMA.associatedChannels[1].enableInterrupt = true;
DMA.associatedChannels[1].destIncrement   = "INCREMENT";
DMA.associatedChannels[1].$name           = "DMA_CH0";
DMA.associatedChannels[1].addressMode     = "b2f";

GPIO1.$name                   = "GPIO_LED";
GPIO1.associatedPins[0].$name = "USER_LED_1";

const SYSCTL = scripting.addModule("/ti/driverlib/SYSCTL", {}, false);
