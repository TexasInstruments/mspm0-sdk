// @cliArgs --device "MSPM0L111X" --package "LQFP-48(PT)" --part "Default"
// @v2CliArgs --device "MSPM0L111X" --package "LQFP-48(PT)"
// @cliArgs --board /ti/boards/LP_MSPM0L1117 --rtos nortos

/**
 * Import the modules used in this configuration.
 */
const NONMAIN       = scripting.addModule("/ti/driverlib/NONMAIN");
const ProjectConfig = scripting.addModule("/ti/project_config/ProjectConfig");

/**
 * Write custom configuration values to the imported modules.
 */
NONMAIN.nonmainWarning               = true;
NONMAIN.staticWriteProtectionMainLow = 0xFFFF00FF;
NONMAIN.staticWriteProtectionNonMain = true;
NONMAIN.bslFlashPluginEnable         = true;
NONMAIN.bslPluginType                = "bslPluginI2C";
NONMAIN.bslPluginHookInit            = "BSL_PI_I2C_init";
NONMAIN.bslPluginHookReceive         = "BSL_PI_I2C_receive";
NONMAIN.bslPluginHookTransmit        = "BSL_PI_I2C_send";
NONMAIN.bslPluginHookDeInit          = "BSL_PI_I2C_deinit";
NONMAIN.bslPluginHookDeInitAddress   = 0x2400;
NONMAIN.bslPluginHookTransmitAddress = 0x2300;
NONMAIN.bslPluginHookReceiveAddress  = 0x2100;
NONMAIN.bslPluginHookInitAddress     = 0x2000;

ProjectConfig.genOpts   = false;
ProjectConfig.genLibs   = false;
ProjectConfig.genLinker = false;
