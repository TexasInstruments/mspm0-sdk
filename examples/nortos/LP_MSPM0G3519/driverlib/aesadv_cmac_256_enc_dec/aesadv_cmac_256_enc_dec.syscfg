/**
 * @cliArgs --device "MSPM0G351X" --part "Default" --package "LQFP-100(PZ)"
 */
// @cliArgs --board /ti/boards/LP_MSPM0G3519 --rtos nortos

/**
 * Import the modules used in this configuration.
 */
const AESADV        = scripting.addModule("/ti/driverlib/AESADV");
const DMA           = scripting.addModule("/ti/driverlib/DMA");
const NONMAIN       = scripting.addModule("/ti/driverlib/NONMAIN");
const SECCONFIG     = scripting.addModule("/ti/driverlib/SECCONFIG");
const SYSCTL        = scripting.addModule("/ti/driverlib/SYSCTL");
const ProjectConfig = scripting.addModule("/ti/project_config/ProjectConfig");

/**
 * Write custom configuration values to the imported modules.
 */
const Board = scripting.addModule("/ti/driverlib/Board", {}, false);

DMA.associatedChannels.create(2);
DMA.associatedChannels[0].enableInterrupt       = true;
DMA.associatedChannels[0].$name                 = "DMA_CH1";
DMA.associatedChannels[0].triggerSelectInternal = "1";
DMA.associatedChannels[0].addressMode           = "b2b";
DMA.associatedChannels[0].transferMode          = "SINGLE_BLOCK";
DMA.associatedChannels[1].triggerSelect         = "AES";
DMA.associatedChannels[1].destIncrement         = "INCREMENT";
DMA.associatedChannels[1].enableInterrupt       = true;
DMA.associatedChannels[1].$name                 = "DMA_CH0";
DMA.associatedChannels[1].addressMode           = "b2f";

NONMAIN.nonmainWarning = true;
NONMAIN.cscExists      = true;

SECCONFIG.cscPrereqAck                = true;
SECCONFIG.enableRollbackProtection    = false;
SECCONFIG.enableStaticSharedSecretKey = false;
SECCONFIG.enableIPProtection          = false;
SECCONFIG.exposeSecurityPrimitives    = false;
SECCONFIG.cscBankSize                 = 131072;
SECCONFIG.cscSecretAddress            = 0x4000;
SECCONFIG.cscSecretSize               = 1024;
SECCONFIG.cscLockStorageSize          = 1024;
SECCONFIG.cscAppImageBaseAddr         = 0x4800;
SECCONFIG.cscAppImageSize             = 10240;
SECCONFIG.keystoreProvisionMethods    = ["compileTime","runTime"];

SYSCTL.clockTreeEn           = true;
SYSCTL.forceDefaultClkConfig = true;

ProjectConfig.genLinker = false;
