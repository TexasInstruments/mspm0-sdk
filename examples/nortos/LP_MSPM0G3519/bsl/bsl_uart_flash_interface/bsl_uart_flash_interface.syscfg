// @cliArgs --device "MSPM0G351X" --package "LQFP-100(PZ)" --part "Default"
// @v2CliArgs --device "MSPM0G3519" --package "LQFP-100(PZ)"
// @cliArgs --board /ti/boards/LP_MSPM0G3519 --rtos nortos

/**
 * Import the modules used in this configuration.
 */
const NONMAIN       = scripting.addModule("/ti/driverlib/NONMAIN");
const ProjectConfig = scripting.addModule("/ti/project_config/ProjectConfig");

/**
 * Write custom configuration values to the imported modules.
 */
NONMAIN.nonmainWarning               = true;
NONMAIN.staticWriteProtectionNonMain = true;
NONMAIN.staticWriteProtectionMainLow = 0xFFFF00FF;
NONMAIN.bslFlashPluginEnable         = true;
NONMAIN.bslPluginType                = "bslPluginUART";
NONMAIN.bslPluginHookInit            = "BSL_PI_UART_init";
NONMAIN.bslPluginHookReceive         = "BSL_PI_UART_receive";
NONMAIN.bslPluginHookTransmit        = "BSL_PI_UART_send";
NONMAIN.bslPluginHookDeInit          = "BSL_PI_UART_deinit";
NONMAIN.bslPluginHookInitAddress     = 0x2000;
NONMAIN.bslPluginHookReceiveAddress  = 0x2100;
NONMAIN.bslPluginHookTransmitAddress = 0x2300;
NONMAIN.bslPluginHookDeInitAddress   = 0x2400;

ProjectConfig.genLinker  = false;
ProjectConfig.genStartup = false;
ProjectConfig.genOpts    = false;
ProjectConfig.genLibs    = false;
