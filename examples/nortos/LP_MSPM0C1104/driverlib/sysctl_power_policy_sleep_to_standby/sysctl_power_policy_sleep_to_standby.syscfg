// @cliArgs --device "MSPM0C110X" --package "VSSOP-20(DGS20)" --part "Default"
// @cliArgs --board /ti/boards/LP_MSPM0C1104 --rtos nortos

/**
 * Import the modules used in this configuration.
 */
const Board  = scripting.addModule("/ti/driverlib/Board");
const GPIO   = scripting.addModule("/ti/driverlib/GPIO", {}, false);
const GPIO1  = GPIO.addInstance();
const SYSCTL = scripting.addModule("/ti/driverlib/SYSCTL");
const TIMER  = scripting.addModule("/ti/driverlib/TIMER", {}, false);
const TIMER1 = TIMER.addInstance();
const TIMER2 = TIMER.addInstance();

/**
 * Write custom configuration values to the imported modules.
 */
const divider1       = system.clockTree["EXCLKDIV"];
divider1.divideValue = 16;

const gate3  = system.clockTree["EXCLKGATE"];
gate3.enable = true;

const gate6  = system.clockTree["MFCLKGATE"];
gate6.enable = true;

const mux2       = system.clockTree["EXCLKMUX"];
mux2.inputSelect = "EXCLKMUX_ULPCLK";

const pinFunction1  = system.clockTree["CLKOUT"];
pinFunction1.enable = true;


GPIO1.$name                          = "GPIO_LEDS";
GPIO1.associatedPins.create(2);
GPIO1.associatedPins[0].$name        = "USER_LED_1";
GPIO1.associatedPins[0].initialValue = "SET";
GPIO1.associatedPins[0].assignedPin  = "22";
GPIO1.associatedPins[1].$name        = "USER_TEST";
GPIO1.associatedPins[1].assignedPin  = "2";
GPIO1.associatedPins[1].initialValue = "SET";

SYSCTL.clockTreeEn = true;
SYSCTL.powerPolicy = "STANDBY0";

TIMER1.$name              = "TIMER_0";
TIMER1.interrupts         = ["ZERO"];
TIMER1.timerMode          = "PERIODIC";
TIMER1.timerClkSrc        = "LFCLK";
TIMER1.timerClkPrescale   = 33;
TIMER1.timerPeriod        = "1000 ms";
TIMER1.peripheral.$assign = "TIMG14";

TIMER2.$name              = "TIMER_1";
TIMER2.timerMode          = "PERIODIC";
TIMER2.timerClkPrescale   = 256;
TIMER2.interrupts         = ["ZERO"];
TIMER2.timerPeriod        = "250ms";
TIMER2.peripheral.$assign = "TIMG8";
