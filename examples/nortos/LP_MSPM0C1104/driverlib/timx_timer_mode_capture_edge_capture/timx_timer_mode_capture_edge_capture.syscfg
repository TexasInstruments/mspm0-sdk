// @cliArgs --device "MSPM0C110X" --package "VSSOP-20(DGS20)" --part "Default"
// @cliArgs --board /ti/boards/LP_MSPM0C1104 --rtos nortos

/**
 * Import the modules used in this configuration.
 */
const CAPTURE  = scripting.addModule("/ti/driverlib/CAPTURE", {}, false);
const CAPTURE1 = CAPTURE.addInstance();
const SYSCTL   = scripting.addModule("/ti/driverlib/SYSCTL");

/**
 * Write custom configuration values to the imported modules.
 */
CAPTURE1.$name                      = "CAPTURE_0";
CAPTURE1.timerClkSrc                = "LFCLK";
CAPTURE1.timerClkPrescale           = 256;
CAPTURE1.interrupts                 = ["CC0_DN"];
CAPTURE1.timerPeriod                = "15.63 s";
CAPTURE1.peripheral.$assign         = "TIMG14";
CAPTURE1.peripheral.ccp0Pin.$assign = "PA23";

const Board = scripting.addModule("/ti/driverlib/Board", {}, false);

SYSCTL.clockTreeEn = true;
