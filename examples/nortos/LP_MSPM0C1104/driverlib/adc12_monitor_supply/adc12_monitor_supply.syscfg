// @cliArgs --device "MSPM0C110X" --package "VSSOP-20(DGS20)" --part "Default"
// @cliArgs --board /ti/boards/LP_MSPM0C1104 --rtos nortos

/**
 * Import the modules used in this configuration.
 */
const ADC12  = scripting.addModule("/ti/driverlib/ADC12", {}, false);
const ADC121 = ADC12.addInstance();
const Board  = scripting.addModule("/ti/driverlib/Board");
const GPIO   = scripting.addModule("/ti/driverlib/GPIO", {}, false);
const GPIO1  = GPIO.addInstance();
const SYSCTL = scripting.addModule("/ti/driverlib/SYSCTL");
const VREF   = scripting.addModule("/ti/driverlib/VREF");

/**
 * Write custom configuration values to the imported modules.
 */
ADC121.$name              = "ADC12_0";
ADC121.repeatMode         = true;
ADC121.sampClkSrc         = "DL_ADC12_CLOCK_ULPCLK";
ADC121.sampClkDiv         = "DL_ADC12_CLOCK_DIVIDE_8";
ADC121.adcMem0chansel     = "DL_ADC12_INPUT_CHAN_15";
ADC121.adcMem0vref        = "VREF";
ADC121.sampleTime0        = "125 us";
ADC121.enabledInterrupts  = ["DL_ADC12_INTERRUPT_MEM0_RESULT_LOADED"];
ADC121.peripheral.$assign = "ADC0";


GPIO1.$name                          = "GPIO_LEDS";
GPIO1.associatedPins.create(2);
GPIO1.associatedPins[0].$name        = "USER_LED_1";
GPIO1.associatedPins[0].initialValue = "SET";
GPIO1.associatedPins[0].assignedPin  = "22";
GPIO1.associatedPins[1].$name        = "USER_TEST";
GPIO1.associatedPins[1].assignedPin  = "2";
GPIO1.associatedPins[1].initialValue = "SET";

SYSCTL.clockTreeEn = true;

VREF.basicIntVolt         = "DL_VREF_BUFCONFIG_OUTPUT_2_5V";
VREF.advClockConfigEnable = true;
VREF.advClkSrc            = "DL_VREF_CLOCK_BUSCLK";
