//@cliArgs --device "MSPM0G321X" --package "LQFP-64(PM)" --part "Default"
//@v2CliArgs --device "MSPM0G3218" --package "LQFP-64(PM)"
// @cliArgs --board /ti/boards/LP_MSPM0G3218 --rtos nortos

/**
 * Import the modules used in this configuration.
 */
const Board         = scripting.addModule("/ti/driverlib/Board");
const GPIO          = scripting.addModule("/ti/driverlib/GPIO", {}, false);
const GPIO1         = GPIO.addInstance();
const RTCB          = scripting.addModule("/ti/driverlib/RTCB");
const ProjectConfig = scripting.addModule("/ti/project_config/ProjectConfig");

/**
 * Write custom configuration values to the imported modules.
 */

GPIO1.$name                              = "GPIO_SWITCHES";
GPIO1.associatedPins.create(2);
GPIO1.associatedPins[0].$name            = "USER_SWITCH_1";
GPIO1.associatedPins[0].direction        = "INPUT";
GPIO1.associatedPins[0].internalResistor = "PULL_UP";
GPIO1.associatedPins[0].interruptEn      = true;
GPIO1.associatedPins[0].polarity         = "RISE_FALL";
GPIO1.associatedPins[0].assignedPort     = "PORTB";
GPIO1.associatedPins[0].pin.$assign      = "PB21";

GPIO1.associatedPins[1].$name            = "USER_SWITCH_2";
GPIO1.associatedPins[1].direction        = "INPUT";
GPIO1.associatedPins[1].interruptEn      = true;
GPIO1.associatedPins[1].polarity         = "RISE_FALL";
GPIO1.associatedPins[1].assignedPort     = "PORTA";
GPIO1.associatedPins[1].assignedPin      = "18";

RTCB.calMonth        = "4";
RTCB.calDOM          = 5;
RTCB.calDOW          = "1";
RTCB.calHour         = 10;
RTCB.calMin          = 32;
RTCB.calSec          = 58;
RTCB.offsetCalFreq   = "512";

const SYSCTL = scripting.addModule("/ti/driverlib/SYSCTL");

SYSCTL.clockTreeEn = true;
SYSCTL.forceDefaultClkConfig = true;
