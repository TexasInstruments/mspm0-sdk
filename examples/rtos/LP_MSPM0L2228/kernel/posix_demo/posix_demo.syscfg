// @cliArgs --device "MSPM0L222X" --package "LQFP-64(PM)" --part "Default"
// @cliArgs --board /ti/boards/LP_MSPM0L2228 --rtos freertos

/**
 * Import the modules used in this configuration.
 */
const ProjectConfig = scripting.addModule("/ti/project_config/ProjectConfig");
const GPIO   = scripting.addModule("/ti/driverlib/GPIO", {}, false);
const GPIO1  = GPIO.addInstance();
const SYSCTL = scripting.addModule("/ti/driverlib/SYSCTL");

/**
 * Write custom configuration values to the imported modules.
 */
ProjectConfig.genDisable = true;

GPIO1.$name                         = "GPIO_LEDS";
GPIO1.associatedPins[0].$name       = "USER_LED_1";
GPIO1.associatedPins[0].assignedPin = "0";
GPIO1.associatedPins[0].initialValue = "SET";
GPIO1.associatedPins[0].pin.$assign = "PA0";

const Board = scripting.addModule("/ti/driverlib/Board", {}, false);
SYSCTL.clockTreeEn = true;
